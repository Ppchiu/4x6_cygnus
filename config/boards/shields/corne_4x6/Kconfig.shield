## config/boards/shields/corne_4x6/Kconfig.shield
```kconfig
config SHIELD_CORNE_4X6_LEFT
    def_bool $(shields_list_contains,corne_4x6_left)

config SHIELD_CORNE_4X6_RIGHT
    def_bool $(shields_list_contains,corne_4x6_right)
```
